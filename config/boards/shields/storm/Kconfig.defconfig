## config/boards/shields/storm/Kconfig.defconfig
```kconfig
if SHIELD_STORM_LEFT

    config ZMK_KEYBOARD_NAME
        default "storm"

    config ZMK_SPLIT_BLE_ROLE_CENTRAL
        default y

endif

if SHIELD_STORM_RIGHT

    config ZMK_KEYBOARD_NAME
        default "storm r"

endif

if SHIELD_STORM_LEFT || SHIELD_STORM_RIGHT

    config ZMK_SPLIT
        default y

endif
```

## config/boards/shields/storm/Kconfig.shield
```kconfig
config SHIELD_STORM_LEFT
    def_bool $(shields_list_contains,storm_left)

config SHIELD_STORM_RIGHT
    def_bool $(shields_list_contains,storm_right)
```
